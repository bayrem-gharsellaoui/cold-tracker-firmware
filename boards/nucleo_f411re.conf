## boards/nucleo_u575zi_q.conf
```kconfig
# Binary name
CONFIG_KERNEL_BIN_NAME="coldtracker-nucleo_u575zi_q"

# Stack sizes
CONFIG_MAIN_STACK_SIZE=4096
CONFIG_SHELL_STACK_SIZE=4096

# Logging
CONFIG_SHELL_BACKEND_SERIAL_LOG_MESSAGE_QUEUE_SIZE=4096
CONFIG_LOG_BUFFER_SIZE=4096
```

## boards/stm32h7_renode_reference_board.conf
```kconfig
# Binary name
CONFIG_KERNEL_BIN_NAME="coldtracker-stm32h7-renode"

# Stack sizes
CONFIG_MAIN_STACK_SIZE=4096
CONFIG_SHELL_STACK_SIZE=4096

# Logging
CONFIG_LOG_BUFFER_SIZE=4096

# Ethernet network configuration
CONFIG_NET_CONFIG_SETTINGS=y
CONFIG_NET_CONFIG_AUTO_INIT=y
CONFIG_NET_CONFIG_NEED_IPV4=y

CONFIG_NET_CONFIG_MY_IPV4_ADDR="192.0.2.1"
CONFIG_NET_CONFIG_MY_IPV4_NETMASK="255.255.255.0"
CONFIG_NET_CONFIG_MY_IPV4_GW="192.0.2.2"
```

## boards/xiao_esp32c3.conf
```kconfig
# Binary name
CONFIG_KERNEL_BIN_NAME="coldtracker-xiao_esp32c3"

# Stack sizes
CONFIG_MAIN_STACK_SIZE=4096
CONFIG_SHELL_STACK_SIZE=4096
CONFIG_SYSTEM_WORKQUEUE_STACK_SIZE=4096
CONFIG_ISR_STACK_SIZE=4096
CONFIG_NET_TCP_WORKQ_STACK_SIZE=4096
CONFIG_NET_SOCKETS_SERVICE_STACK_SIZE=4096
CONFIG_NET_CONNECTION_MANAGER_MONITOR_STACK_SIZE=4096

# Logging
CONFIG_SHELL_BACKEND_SERIAL_LOG_MESSAGE_QUEUE_SIZE=4096
CONFIG_LOG_BUFFER_SIZE=4096
```

## snippets/ncm/boards/nucleo_u575zi_q.conf
```kconfig
CONFIG_KERNEL_BIN_NAME="coldtracker-nucleo_u575zi_q-net-ncm"

CONFIG_SHELL_BACKEND_SERIAL_LOG_MESSAGE_QUEUE_SIZE=4096
```

## snippets/wifi/boards/xiao_esp32c3.conf
```kconfig
# Network variant binary name
CONFIG_KERNEL_BIN_NAME="coldtracker-xiao_esp32c3-net-wifi"

# ESP32 Wi-Fi driver
CONFIG_WIFI_ESP32=y

# Stack sizes
CONFIG_NET_TCP_WORKQ_STACK_SIZE=4096
CONFIG_NET_SOCKETS_SERVICE_STACK_SIZE=4096
CONFIG_NET_CONNECTION_MANAGER_MONITOR_STACK_SIZE=4096
CONFIG_SHELL_BACKEND_SERIAL_LOG_MESSAGE_QUEUE_SIZE=4096
```
